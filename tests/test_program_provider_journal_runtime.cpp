// ProgramRuntime-level qualification of the durable provider dispatch journal (#295).
//
// Every call identity below is generated by ProgramRuntime/Core; no test builds a
// ProgramCoreProviderCallContext or ProviderCallIdentity by hand to start a run.
// Recovery is real: runtime, catalog, engine cache, journal, transition/program
// store and checkpoint store are destroyed and reopened from their SQLite files
// (or from a byte-consistent crash image of them) before the run is continued.
#include <neograph/program/program.h>
#include <neograph/program/sqlite_provider_call_broker.h>
#include <neograph/program/sqlite_store.h>
#include <neograph/program/sqlite_transition_store.h>
#include <neograph/graph/node.h>
#include <neograph/graph/sqlite_checkpoint.h>
#include <neograph/tool_dispatch.h>
#include <neograph/tool_effect_broker.h>
#include "fixtures/typed_provider.h"

#include <sqlite3.h>
#include <gtest/gtest.h>

#include <algorithm>
#include <atomic>
#include <chrono>
#include <condition_variable>
#include <filesystem>
#include <functional>
#include <map>
#include <memory>
#include <mutex>
#include <optional>
#include <set>
#include <stdexcept>
#include <thread>
#include <string_view>
#include <vector>

namespace {
using namespace neograph;
using namespace neograph::program;
using Journal = SQLiteProgramProviderCallJournal;

constexpr auto kPatience = std::chrono::seconds(30);

std::string digest(char c) { return "sha256:" + std::string(64, c); }

// ---------------------------------------------------------------------------
// Files
// ---------------------------------------------------------------------------

struct TempDir {
    explicit TempDir(const std::string& name) {
        static std::atomic<unsigned> sequence{0};
        path = std::filesystem::canonical(std::filesystem::temp_directory_path()) /
               ("neograph-provider-journal-runtime-" + name + "-" +
                std::to_string(std::chrono::steady_clock::now().time_since_epoch().count()) + "-" +
                std::to_string(sequence++));
        std::filesystem::create_directories(path);
    }
    ~TempDir() {
        std::error_code error;
        std::filesystem::remove_all(path, error);
    }
    TempDir(const TempDir&) = delete;
    TempDir& operator=(const TempDir&) = delete;
    std::string provider_db() const { return (path / "provider.sqlite").string(); }
    std::string program_db() const { return (path / "program.sqlite").string(); }
    std::string checkpoint_db() const { return (path / "checkpoint.sqlite").string(); }
    std::filesystem::path path;
};

struct Connection {
    explicit Connection(const std::string& file, int flags = SQLITE_OPEN_READWRITE) {
        if (sqlite3_open_v2(file.c_str(), &db, flags, nullptr) != SQLITE_OK) {
            const std::string message = db ? sqlite3_errmsg(db) : "sqlite allocation failed";
            if (db) sqlite3_close_v2(db);
            db = nullptr;
            throw std::runtime_error("cannot open " + file + ": " + message);
        }
    }
    ~Connection() { if (db) sqlite3_close_v2(db); }
    Connection(const Connection&) = delete;
    Connection& operator=(const Connection&) = delete;
    void exec(const std::string& sql) const {
        char* message = nullptr;
        if (sqlite3_exec(db, sql.c_str(), nullptr, nullptr, &message) != SQLITE_OK) {
            const std::string text = message ? message : "sqlite error";
            sqlite3_free(message);
            throw std::runtime_error(text);
        }
    }
    sqlite3* db = nullptr;
};

// Quiesced copy: every store of the source must already be closed.
void copy_closed_files(const std::filesystem::path& from, const std::filesystem::path& to) {
    std::filesystem::create_directories(to);
    for (const auto& entry : std::filesystem::directory_iterator(from))
        std::filesystem::copy_file(entry.path(), to / entry.path().filename(),
                                   std::filesystem::copy_options::overwrite_existing);
}

// Crash image of live databases: the committed state at this instant, with no
// in-flight transaction. Taken through the SQLite backup API from a second
// connection, exactly what a restart after power loss would find.
void crash_image(const std::filesystem::path& from, const std::filesystem::path& to) {
    std::filesystem::create_directories(to);
    for (const auto& entry : std::filesystem::directory_iterator(from)) {
        if (entry.path().extension() != ".sqlite") continue;
        Connection source(entry.path().string(), SQLITE_OPEN_READONLY);
        Connection target((to / entry.path().filename()).string(),
                          SQLITE_OPEN_READWRITE | SQLITE_OPEN_CREATE);
        auto* backup = sqlite3_backup_init(target.db, "main", source.db, "main");
        if (!backup) throw std::runtime_error("sqlite backup init failed");
        const auto step = sqlite3_backup_step(backup, -1);
        const auto finish = sqlite3_backup_finish(backup);
        if (step != SQLITE_DONE || finish != SQLITE_OK)
            throw std::runtime_error("sqlite backup failed");
    }
}

struct Row {
    std::string owner, id, state, original_attempt, model, request, binding, provider_name,
        family, mode, completion;
    json slot;
};
std::vector<Row> rows(const std::string& provider_db) {
    Connection db(provider_db, SQLITE_OPEN_READONLY);
    sqlite3_stmt* stmt = nullptr;
    if (sqlite3_prepare_v2(db.db,
            "SELECT owner_scope,dispatch_id,state,original_attempt,model,request_digest,"
            "provider_binding_identity,provider_name,family,mode,slot,completion "
            "FROM ng_program_provider_calls ORDER BY rowid", -1, &stmt, nullptr) != SQLITE_OK)
        throw std::runtime_error(sqlite3_errmsg(db.db));
    const std::unique_ptr<sqlite3_stmt, decltype(&sqlite3_finalize)> statement(stmt, sqlite3_finalize);
    std::vector<Row> result;
    const auto text = [&](int column) {
        const auto* bytes = sqlite3_column_text(stmt, column);
        return bytes ? std::string(reinterpret_cast<const char*>(bytes),
                                   static_cast<std::size_t>(sqlite3_column_bytes(stmt, column)))
                     : std::string();
    };
    int step;
    while ((step = sqlite3_step(stmt)) == SQLITE_ROW) {
        Row row{text(0), text(1), text(2), text(3), text(4), text(5), text(6), text(7), text(8),
                text(9), text(11), json::parse(text(10))};
        result.push_back(std::move(row));
    }
    if (step != SQLITE_DONE) throw std::runtime_error(sqlite3_errmsg(db.db));
    return result;
}

// ---------------------------------------------------------------------------
// Provider / tool doubles shared by every reopened process generation
// ---------------------------------------------------------------------------

enum class Script { Plain, React };

struct Observed {
    std::string generation;     // which materialized provider object served the call
    std::string prompt;         // first user text
    bool observation = false;   // request carried the Tool observation
    std::string model;
};

struct Shared {
    std::atomic<int> transport{0};
    std::atomic<int> tool_executions{0};
    std::atomic<int> generations{0};
    std::mutex mutex;
    std::vector<Observed> observed;
    Script script = Script::Plain;
    // Runs inside the transport before it answers; may block or throw.
    std::function<void(int ordinal, const ProviderRequest&)> on_transport;
    // Approval node request, read when the node runs so a "restart" may change it.
    std::string node_model = "test-model";
    std::string node_prompt = "question";
    bool interrupt_after_call = false;
    bool interrupt_on_uncertain = false;
    bool interrupt_before_call = false;

    std::vector<Observed> snapshot() {
        std::lock_guard lock(mutex);
        return observed;
    }
};

const sp::chat::Request& chat_request(const ProviderRequest& request) {
    return std::get<sp::chat::Request>(request.payload);
}

sp::runtime::Result respond(const std::shared_ptr<Shared>& shared, const std::string& generation,
                            const ProviderRequest& request) {
    Observed seen;
    seen.generation = generation;
    seen.model = chat_request(request).model;
    std::string observation;
    for (const auto& message : chat_request(request).canonical_messages) {
        for (const auto& part : message.parts) {
            if (message.role == sp::Role::User && seen.prompt.empty())
                if (const auto* text = std::get_if<sp::Text>(&part)) seen.prompt = text->value;
            if (const auto* result = std::get_if<sp::ToolResult>(&part)) {
                seen.observation = true;
                observation = result->content;
            }
        }
    }
    {
        std::lock_guard lock(shared->mutex);
        shared->observed.push_back(seen);
    }
    if (shared->script == Script::React && !seen.observation)
        return neograph::test::success(std::vector<sp::Message>{
            {"call", sp::Role::Assistant, {sp::Text{"Thought: look it up"},
                sp::ToolCall{"tool-1", "observe", sp::ToolCallKind::ClientExecuted,
                             neograph::test::document("{}")}}}});
    return neograph::test::success(
        "answer(" + seen.prompt + (seen.observation ? "|" + observation : std::string()) + ")");
}

std::shared_ptr<Provider> make_provider(std::shared_ptr<Shared> shared, std::string generation) {
    return std::make_shared<neograph::test::LocalProvider>(
        [shared = std::move(shared), generation = std::move(generation)](
            ProviderRequest request, const auto&, const auto&)
            -> asio::awaitable<sp::runtime::Result> {
            const int ordinal = ++shared->transport;
            if (shared->on_transport) shared->on_transport(ordinal, request);
            co_return respond(shared, generation, request);
        },
        "journal-runtime-provider", neograph::test::bounded_client());
}

class ObservationTool final : public Tool {
public:
    explicit ObservationTool(std::shared_ptr<Shared> shared) : shared_(std::move(shared)) {}
    ChatTool get_definition() const override {
        return {"observe", "Return one observation", json{{"type", "object"}}};
    }
    std::string get_name() const override { return "observe"; }
    std::string execute(const json&) override {
        ++shared_->tool_executions;
        return "tool-observation";
    }
private:
    std::shared_ptr<Shared> shared_;
};

class PassThroughEffects final : public ToolEffectBroker {
public:
    asio::awaitable<ToolExecutionResult> execute(
        ToolEffectIdentity, Tool& tool, json arguments, ToolExecutionContext context) override {
        co_return co_await context.controller->execute_result_async(
            tool, std::move(arguments), context);
    }
};

// A host node that calls the Provider through the runtime-bound broker and may
// interrupt for approval: the call's identity is the one Core generates for it.
class ApprovalNode final : public graph::GraphNode {
public:
    ApprovalNode(std::shared_ptr<Provider> provider, std::shared_ptr<Shared> shared)
        : provider_(std::move(provider)), shared_(std::move(shared)) {}
    std::string get_name() const override { return "work"; }
    asio::awaitable<graph::NodeOutput> run(graph::NodeInput in) override {
        if (shared_->interrupt_before_call && !in.ctx.resume_value)
            throw graph::NodeInterrupt("approve provider dispatch", json{{"request", "approve"}});
        auto request = neograph::test::request(shared_->node_model, shared_->node_prompt);
        std::get<sp::chat::Request>(request.payload).max_output_tokens = 1;
        const auto broker = graph::provider_call_broker(in.ctx);
        if (!broker) throw std::runtime_error("Program provider broker is absent");
        sp::runtime::Result result;
        try {
            result = co_await graph::observe_provider_result(
                in.ctx, broker->invoke(graph::make_provider_call_identity(in.ctx, get_name()),
                                       provider_, std::move(request)));
        } catch (const std::runtime_error& error) {
            if (shared_->interrupt_on_uncertain && !in.ctx.resume_value &&
                std::string_view(error.what()) == "link lost after the request was sent")
                throw graph::NodeInterrupt("provider outcome uncertain",
                                           json{{"request", "reconcile"}});
            throw;
        }
        graph::record_usage(in.ctx, result);
        if (shared_->interrupt_after_call && !in.ctx.resume_value)
            throw graph::NodeInterrupt("approve model output", json{{"request", "approve"}});
        graph::NodeOutput output;
        output.writes.push_back(graph::ChannelWrite{
            "value", neograph::test::text(outcome_or_throw(result))});
        co_return output;
    }
private:
    std::shared_ptr<Provider> provider_;
    std::shared_ptr<Shared> shared_;
};

// ---------------------------------------------------------------------------
// One process generation: every store/cache/runtime is opened from its files
// ---------------------------------------------------------------------------

enum class Topology { Llm, React, ReactPausedBeforeTools, Approval };

struct Options {
    std::uint64_t model_tokens = 1000;   // 0 = unbounded dispatch
    std::string deployment = digest('a');
    std::size_t threads = 2;
    // Child-capable roots use checkpoint recovery rather than migration leases.
    // Set at admission and keep identical across every process generation.
    bool child_capable = false;
};

class Wire {
public:
    Wire(const TempDir& files, std::shared_ptr<Shared> shared, Options options = {})
        : files_(files), shared_(std::move(shared)), options_(std::move(options)) { open(); }
    ~Wire() { close(); }
    Wire(const Wire&) = delete;
    Wire& operator=(const Wire&) = delete;

    void close() {
        runtime_.reset();
        catalog_.reset();
        journal_.reset();
        checkpoints_.reset();
        transitions_.reset();
        store_.reset();
    }
    void open() {
        const auto provider_identity = ExecutableIdentity{
            ExecutableKind::Provider, "journal-runtime-provider", "1.0.0", digest('1')};
        const auto tool_identity = ExecutableIdentity{
            ExecutableKind::Tool, "observe", "1.0.0", digest('2')};
        const auto manifest = [](ExecutableIdentity identity,
                                 std::vector<ExecutableIdentity> requires_ = {}) {
            return ExecutableManifest{std::move(identity), EffectMode::Brokered,
                                      "journal-runtime", {}, {}, std::move(requires_)};
        };
        RegistrySnapshotBuilder builder;
        builder.add_provider(manifest(provider_identity),
                             ProviderMetadata{json::object(), json::object()});
        builder.add_tool(manifest(tool_identity), ToolMetadata{json::object(), json::object()});
        builder.add_core_llm_call(
            manifest({ExecutableKind::Node, "llm_call", "1.0.0", digest('3')}),
            [provider_identity, tool_identity](const json&) {
                return std::vector<ExecutableIdentity>{provider_identity, tool_identity};
            });
        builder.add_core_tool_dispatch(
            manifest({ExecutableKind::Node, "tool_dispatch", "1.0.0", digest('4')}),
            [tool_identity](const json&) { return std::vector<ExecutableIdentity>{tool_identity}; });
        builder.add_reducer(manifest({ExecutableKind::Reducer, "append", "1.0.0", digest('5')}),
            [](const json& current, const json& incoming) {
                json merged = current.is_array() ? current : json::array();
                if (incoming.is_array()) for (const auto& item : incoming) merged.push_back(item);
                else merged.push_back(incoming);
                return merged;
            });
        builder.add_reducer(manifest({ExecutableKind::Reducer, "overwrite", "1.0.0", digest('6')}),
            [](const json&, const json& incoming) { return incoming; });
        builder.add_condition(
            manifest({ExecutableKind::Condition, "has_tool_calls", "1.0.0", digest('7')}),
            [](const graph::GraphState& state) -> std::string {
                return pending_client_tool_calls(state.get_provider_messages()).empty()
                    ? "false" : "true";
            },
            graph::ConditionSpec{{"false", "true"}, false});
        builder.add_host_brokered_node(
            manifest({ExecutableKind::Node, "approval_node", "1.0.0", digest('8')},
                     {provider_identity}),
            [shared = shared_](const std::string&, const json&, const graph::NodeContext& context) {
                return std::make_unique<ApprovalNode>(context.provider, shared);
            },
            json{{"type", "object"}}, json{{"writes", json::array({"value"})}});
        registry_.emplace(std::move(builder).build());

        AdmissionProfileBuilder profile_builder;
        profile_builder.id("journal-runtime-profile").semantic_version("1.0.0").registry(*registry_)
            .mode(AdmissionMode::MultiTenant).max_program_schema_version(2)
            .allow_source_kind(SourceKind::CppBuilder).allow_effect_mode(EffectMode::Brokered);
        for (const auto& identity : registry_->identities()) profile_builder.allow_executable(identity);
        profile_.emplace(std::move(profile_builder).build());

        store_ = std::make_shared<SQLiteProgramStore>(files_.program_db());
        transitions_ = std::make_shared<SQLiteProgramTransitionStore>(files_.program_db());
        checkpoints_ = std::make_shared<graph::SqliteCheckpointStore>(files_.checkpoint_db());
        journal_ = std::make_shared<Journal>(files_.provider_db());
        epoch_ = ++next_epoch_;

        CatalogConfig config{store_, *registry_, std::make_shared<EngineGenerationCache>(),
                             "journal-runtime/v1"};
        config.capability_binder = [shared = shared_, provider_identity, tool_identity,
                                    epoch = epoch_,
                                    tokens = options_.model_tokens](
            const std::vector<ExecutableIdentity>& requested) {
            CatalogCapabilityBinding binding;
            binding.node_context.provider = make_provider(
                shared, "g" + std::to_string(epoch) + "." + std::to_string(++shared->generations));
            binding.node_context.model = "test-model";
            if (tokens) binding.node_context.provider_controls.max_output_tokens = 1;
            std::vector<std::unique_ptr<Tool>> tools;
            for (const auto& identity : requested) {
                binding.receipts.push_back({identity, digest('d')});
                if (identity == tool_identity) tools.push_back(std::make_unique<ObservationTool>(shared));
            }
            binding.tools = ToolSet(std::move(tools));
            return binding;
        };
        catalog_ = std::make_shared<ProgramCatalog>(std::move(config));

        RuntimeConfig runtime;
        runtime.catalog = catalog_;
        runtime.checkpoints = checkpoints_;
        runtime.transitions = transitions_;
        runtime.scheduler_threads = options_.threads;
        runtime.require_core_provider_call_broker = true;
        runtime.core_provider_call_resolver =
            [journal = journal_, deployment = options_.deployment](const auto& context) {
                return journal->bind(context, deployment);
            };
        runtime.core_tool_grant_resolver = [](const ProgramCoreToolGrantContext& context)
            -> std::optional<ProgramCoreToolGrant> {
            ProgramCoreToolGrant grant;
            grant.owner_scope = std::string(context.owner_scope);
            grant.program_version_id = std::string(context.program_version_id);
            grant.run_id = std::string(context.run_id);
            grant.operation_id = std::string(context.operation_id);
            grant.attempt = context.attempt;
            grant.grant_id = "journal-runtime-grant";
            grant.binding_fingerprint = std::string(context.binding_fingerprint);
            grant.gate = [](ToolCall, ToolGateContext) -> asio::awaitable<ToolDecision> {
                co_return ToolDecision::allow();
            };
            grant.controller = std::make_shared<ToolExecutionController>();
            grant.effect_broker = std::make_shared<PassThroughEffects>();
            return grant;
        };
        runtime_ = std::make_unique<ProgramRuntime>(std::move(runtime));
    }

    json definition(Topology topology) const {
        json definition{{"schema_version", 1}, {"name", "main"},
                        {"conditional_edges", json::array()}};
        if (topology == Topology::Approval) {
            definition["channels"] = {{"value", {{"reducer", "overwrite"}, {"initial", ""}}}};
            definition["nodes"] = {{"work", {{"type", "approval_node"}}}};
            definition["edges"] = json::array({{{"from", "__start__"}, {"to", "work"}},
                                               {{"from", "work"}, {"to", "__end__"}}});
            return definition;
        }
        definition["channels"] = {{"messages", {{"reducer", "append"}}}};
        if (topology == Topology::Llm) {
            definition["nodes"] = {{"llm", {{"type", "llm_call"}}}};
            definition["edges"] = json::array({{{"from", "__start__"}, {"to", "llm"}},
                                               {{"from", "llm"}, {"to", "__end__"}}});
            return definition;
        }
        definition["nodes"] = {{"llm", {{"type", "llm_call"}}},
                               {"tools", {{"type", "tool_dispatch"}}}};
        definition["edges"] = json::array({{{"from", "__start__"}, {"to", "llm"}},
                                           {{"from", "tools"}, {"to", "llm"}}});
        definition["conditional_edges"] = json::array({{{"from", "llm"},
            {"condition", "has_tool_calls"}, {"routes", {{"true", "tools"}, {"false", "__end__"}}}}});
        if (topology == Topology::ReactPausedBeforeTools)
            definition["interrupt_before"] = json::array({"tools"});
        return definition;
    }

    ProgramVersion admit(const std::string& owner, Topology topology) {
        json document{
            {"program_schema_version", 2U},
            {"input_contract", {{"schema_version", 1}, {"schema", json::object()}}},
            {"output_contract", {{"schema_version", 1}, {"schema", json::object()}}},
            {"root", {{"op", "call_core"}, {"name", "main"}, {"definition", definition(topology)}}},
            {"declared_budget_requirements", json::array({
                json{{"resource", "wall_time_ms"}, {"minimum", 1}, {"maximum", 10000}},
                json{{"resource", "model_tokens"}, {"minimum", 0}, {"maximum", 1000000}},
                json{{"resource", "monetary_microunits"}, {"minimum", 0}, {"maximum", 0}},
                json{{"resource", "max_concurrency"}, {"minimum", 1}, {"maximum", 1}},
                json{{"resource", "max_program_operations"}, {"minimum", 1}, {"maximum", 1}},
                json{{"resource", "max_core_steps"}, {"minimum", 1}, {"maximum", 20}},
                json{{"resource", "max_dynamic_compiles"}, {"minimum", 0}, {"maximum", 0}},
                json{{"resource", "max_child_depth"}, {"minimum", 0},
                     {"maximum", options_.child_capable ? 1 : 0}},
                json{{"resource", "max_total_children"}, {"minimum", 0},
                     {"maximum", options_.child_capable ? 1 : 0}}})}};
        ProgramCompiler compiler(*registry_, {"journal-runtime/v1"});
        const auto bundle = compiler.compile(
            ProgramSource::from_cpp_builder("journal-runtime", 2, std::move(document)));
        PolicySnapshotBuilder policy;
        policy.id("journal-runtime-policy").semantic_version("1.0.0").owner_scope(owner)
            .admission_profile(*profile_)
            .budget_ceiling(BudgetLimits{10000, 1000000, 1, 1, 1, 20, 1,
                                        options_.child_capable ? 1U : 0U,
                                        options_.child_capable ? 1U : 0U});
        return catalog_->admit(bundle, ProgramAdmission{owner, *profile_, std::move(policy).build(), {}});
    }
    ProgramVersion resolve(const std::string& owner, const std::string& id) {
        auto version = catalog_->resolve_version(owner, id);
        if (!version) throw std::runtime_error("admitted version was not recovered");
        return *version;
    }
    RunBudget budget() const {
        return RunBudget{10000, options_.model_tokens, 0, 1, 1, 20, 0,
                         options_.child_capable ? 1U : 0U,
                         options_.child_capable ? 1U : 0U};
    }
    ProgramInvocation invocation(const std::string& run_id, const std::string& prompt,
                                 Topology topology) const {
        ProgramInvocation invocation{
            topology == Topology::Approval ? json::object()
                : json{{"messages", json::array({json{{"role", "user"}, {"content", prompt}}})}},
            budget(), "trace-" + run_id, {}};
        invocation.requested_run_id = run_id;
        return invocation;
    }

    ProgramRuntime& runtime() { return *runtime_; }
    Journal& journal() { return *journal_; }

private:
    const TempDir& files_;
    std::shared_ptr<Shared> shared_;
    Options options_;
    std::optional<RegistrySnapshot> registry_;
    std::optional<AdmissionProfile> profile_;
    std::shared_ptr<SQLiteProgramStore> store_;
    std::shared_ptr<SQLiteProgramTransitionStore> transitions_;
    std::shared_ptr<graph::SqliteCheckpointStore> checkpoints_;
    std::shared_ptr<Journal> journal_;
    std::shared_ptr<ProgramCatalog> catalog_;
    std::unique_ptr<ProgramRuntime> runtime_;
    inline static std::atomic<unsigned> next_epoch_{0};
    unsigned epoch_ = 0;
};

ProgramResume resume_after(const ProgramResult& interrupted, std::string trace,
                           json value = json::object()) {
    const auto interrupt = interrupted.interrupt();
    if (!interrupt || !interrupt->pending_input)
        throw std::logic_error("run is not waiting for host input");
    return ProgramResume{std::move(value), std::move(trace), {},
                         interrupt->pending_input->call_id()};
}


class Rendezvous {
public:
    explicit Rendezvous(int parties) : parties_(parties) {}
    void arrive_and_wait() {
        std::unique_lock lock(mutex_);
        ++arrived_;
        cv_.notify_all();
        if (!cv_.wait_for(lock, kPatience, [&] { return arrived_ >= parties_; }))
            throw std::runtime_error("the overlapping dispatch never arrived");
    }
    int arrived() {
        std::lock_guard lock(mutex_);
        return arrived_;
    }
private:
    std::mutex mutex_;
    std::condition_variable cv_;
    int parties_;
    int arrived_ = 0;
};
} // namespace


namespace {
std::string failure_text(const ProgramResult& result) {
    return result.failure() ? result.failure()->code + ": " + result.failure()->message + " " +
                                  result.failure()->witness.dump()
                            : "no failure";
}
const Row& row_for_run(const std::vector<Row>& all, const std::string& run) {
    for (const auto& row : all)
        if (row.slot.at("run_id") == run) return row;
    throw std::out_of_range("no journal row for " + run);
}
bool same_rows(const std::vector<Row>& left, const std::vector<Row>& right) {
    if (left.size() != right.size()) return false;
    for (std::size_t i = 0; i < left.size(); ++i)
        if (left[i].owner != right[i].owner || left[i].id != right[i].id ||
            left[i].state != right[i].state ||
            left[i].original_attempt != right[i].original_attempt ||
            left[i].request != right[i].request || left[i].binding != right[i].binding ||
            left[i].model != right[i].model || left[i].provider_name != right[i].provider_name ||
            left[i].family != right[i].family || left[i].mode != right[i].mode ||
            left[i].slot != right[i].slot || left[i].completion != right[i].completion)
            return false;
    return true;
}
} // namespace

// (a) ---------------------------------------------------------------------

TEST(ProgramProviderJournalRuntime, OverlappingRunsOnOneAdmittedEngineJournalUnderTheirOwnKeys) {
    TempDir files("overlap");
    auto shared = std::make_shared<Shared>();
    Rendezvous both_in_flight(3);
    shared->on_transport = [&](int, const ProviderRequest&) { both_in_flight.arrive_and_wait(); };
    std::string version_a, version_b;
    {
        Options options;
        options.threads = 3;
        Wire wire(files, shared, options);
        const auto a = wire.admit("tenant:a", Topology::Llm);
        const auto b = wire.admit("tenant:b", Topology::Llm);
        version_a = a.id();
        version_b = b.id();
        auto first = wire.runtime().start("tenant:a", a, wire.invocation("run-a1", "question-a1", Topology::Llm));
        auto second = wire.runtime().start("tenant:a", a, wire.invocation("run-a2", "question-a2", Topology::Llm));
        auto third = wire.runtime().start("tenant:b", b, wire.invocation("run-b1", "question-b1", Topology::Llm));
        const auto left = first.wait();
        const auto middle = second.wait();
        const auto right = third.wait();
        for (const auto* result : {&left, &middle, &right})
            ASSERT_EQ(result->status(), ProgramTerminalStatus::Completed) << failure_text(*result);
        EXPECT_EQ(both_in_flight.arrived(), 3) << "all three transports were in flight together";
        EXPECT_NE(left.output().dump().find("answer(question-a1)"), std::string::npos);
        EXPECT_NE(middle.output().dump().find("answer(question-a2)"), std::string::npos);
        EXPECT_NE(right.output().dump().find("answer(question-b1)"), std::string::npos);
    }
    EXPECT_EQ(shared->transport.load(), 3);
    const auto observed = shared->snapshot();
    ASSERT_EQ(observed.size(), 3U);
    std::set<std::string> engines;
    for (const auto& call : observed) engines.insert(call.generation);
    EXPECT_EQ(engines.size(), 1U) << "both owners and all runs must dispatch through one admitted engine";

    const auto all = rows(files.provider_db());
    ASSERT_EQ(all.size(), 3U);
    std::set<std::string> ids, threads, requests;
    const std::map<std::string, std::pair<std::string, std::string>> expected{
        {"run-a1", {"tenant:a", version_a}}, {"run-a2", {"tenant:a", version_a}},
        {"run-b1", {"tenant:b", version_b}}};
    for (const auto& [run, owner_version] : expected) {
        const auto& row = row_for_run(all, run);
        EXPECT_EQ(row.owner, owner_version.first);
        EXPECT_EQ(row.slot.at("owner_scope"), owner_version.first);
        EXPECT_EQ(row.slot.at("program_version_id"), owner_version.second);
        EXPECT_EQ(row.slot.at("operation_id"), "root");
        EXPECT_EQ(row.slot.at("node_name"), "llm");
        EXPECT_EQ(row.slot.at("call_ordinal"), 0);
        EXPECT_FALSE(row.slot.at("thread_id").get<std::string>().empty());
        EXPECT_FALSE(row.slot.at("task_id").get<std::string>().empty());
        EXPECT_EQ(row.state, "succeeded");
        EXPECT_EQ(row.original_attempt, "1");
        ids.insert(row.id);
        threads.insert(row.slot.at("thread_id").get<std::string>());
        requests.insert(row.request);
    }
    EXPECT_EQ(ids.size(), 3U);
    EXPECT_EQ(threads.size(), 3U) << "each run owns its Core thread";
    EXPECT_EQ(requests.size(), 3U) << "no run's request was bound to another run's slot";

    // A cold process: the three completions are recovered, never re-dispatched,
    // and an owner can read only its own receipts.
    Wire reopened(files, shared);
    for (const auto& [run, owner_version] : expected) {
        const auto restored = reopened.runtime().reconnect(owner_version.first, run).wait();
        EXPECT_EQ(restored.status(), ProgramTerminalStatus::Completed);
        EXPECT_NE(restored.output().dump().find("answer(question-" + run.substr(4) + ")"),
                  std::string::npos);
        const auto& row = row_for_run(all, run);
        const auto receipt = reopened.journal().inspect(owner_version.first, row.id);
        ASSERT_TRUE(receipt);
        EXPECT_EQ(receipt->state, Journal::State::Succeeded);
        EXPECT_FALSE(reopened.journal().inspect(owner_version.first == "tenant:a" ? "tenant:b" : "tenant:a",
                                                row.id));
    }
    EXPECT_EQ(shared->transport.load(), 3);
    EXPECT_TRUE(same_rows(rows(files.provider_db()), all));
}

// (b) ---------------------------------------------------------------------

TEST(ProgramProviderJournalRuntime, AdvancedAttemptReusesCompletedSlotWithoutTransport) {
    TempDir files("advance");
    auto shared = std::make_shared<Shared>();
    shared->interrupt_after_call = true;
    const std::string owner = "tenant:advance";
    const std::string run = "advance-run";
    ProgramResult interrupted;
    std::vector<Row> before;
    {
        Wire wire(files, shared);
        const auto version = wire.admit(owner, Topology::Approval);
        interrupted = wire.runtime().run(owner, version, wire.invocation(run, "", Topology::Approval));
        ASSERT_EQ(interrupted.status(), ProgramTerminalStatus::Interrupted) << failure_text(interrupted);
        EXPECT_EQ(interrupted.attempt(), 1U);
        EXPECT_EQ(shared->transport.load(), 1);
        before = rows(files.provider_db());
        ASSERT_EQ(before.size(), 1U);
        EXPECT_EQ(before[0].state, "succeeded");
        EXPECT_EQ(before[0].original_attempt, "1");
    }
    Wire reopened(files, shared);
    const auto reconnected = reopened.runtime().reconnect(owner, run).wait();
    ASSERT_EQ(reconnected.status(), ProgramTerminalStatus::Interrupted);
    EXPECT_EQ(shared->transport.load(), 1);

    const auto resumed = reopened.runtime().resume(owner, run, resume_after(interrupted, "trace-advance-resume")).wait();
    ASSERT_EQ(resumed.status(), ProgramTerminalStatus::Completed) << failure_text(resumed);
    EXPECT_EQ(resumed.attempt(), 2U) << "resume advanced the Program attempt";
    EXPECT_EQ(shared->transport.load(), 1) << "the existing completion was reused, not dispatched again";
    EXPECT_NE(resumed.output().dump().find("answer(question)"), std::string::npos);
    const auto after = rows(files.provider_db());
    ASSERT_EQ(after.size(), 1U) << "attempt is provenance, not part of the logical slot";
    EXPECT_EQ(after[0].id, before[0].id);
    EXPECT_EQ(after[0].original_attempt, "1");
    EXPECT_TRUE(same_rows(after, before));
    ASSERT_TRUE(reopened.journal().inspect(owner, after[0].id));
    EXPECT_EQ(reopened.journal().inspect(owner, after[0].id)->original_attempt, "1");
}

// (c) ---------------------------------------------------------------------

TEST(ProgramProviderJournalRuntime, MarkerWriteFailureDispatchesNothing) {
    TempDir files("marker-fault");
    auto shared = std::make_shared<Shared>();
    Wire wire(files, shared);
    const auto version = wire.admit("tenant:fault", Topology::Llm);
    Connection fault(files.provider_db());
    fault.exec("CREATE TRIGGER deny_marker BEFORE INSERT ON ng_program_provider_calls "
               "BEGIN SELECT RAISE(FAIL, 'injected marker failure'); END");
    const auto failed = wire.runtime().run("tenant:fault", version,
                                           wire.invocation("fault-run", "question", Topology::Llm));
    EXPECT_EQ(failed.status(), ProgramTerminalStatus::Failed);
    EXPECT_NE(failure_text(failed).find("injected marker failure"), std::string::npos)
        << failure_text(failed);
    EXPECT_EQ(shared->transport.load(), 0) << "no marker, no Provider call";
    EXPECT_TRUE(rows(files.provider_db()).empty());
    // The trigger was the only cause: the same Program dispatches once it is gone.
    fault.exec("DROP TRIGGER deny_marker");
    const auto healthy = wire.runtime().run("tenant:fault", version,
                                            wire.invocation("healthy-run", "question", Topology::Llm));
    EXPECT_EQ(healthy.status(), ProgramTerminalStatus::Completed) << failure_text(healthy);
    EXPECT_EQ(shared->transport.load(), 1);
    EXPECT_EQ(rows(files.provider_db()).size(), 1U);
}

TEST(ProgramProviderJournalRuntime, MarkerWriteFailureOnSecondTurnKeepsFirstTurnAndSendsNothingMore) {
    TempDir files("marker-fault-second");
    auto shared = std::make_shared<Shared>();
    shared->script = Script::React;
    shared->on_transport = [&](int ordinal, const ProviderRequest&) {
        if (ordinal == 1)
            Connection(files.provider_db()).exec("CREATE TRIGGER deny_marker BEFORE INSERT ON ng_program_provider_calls "
                       "BEGIN SELECT RAISE(FAIL, 'injected marker failure'); END");
    };
    Wire wire(files, shared);
    const auto version = wire.admit("tenant:fault", Topology::React);
    const auto failed = wire.runtime().run("tenant:fault", version,
                                           wire.invocation("fault-run", "question", Topology::React));
    EXPECT_EQ(failed.status(), ProgramTerminalStatus::Failed);
    EXPECT_NE(failure_text(failed).find("injected marker failure"), std::string::npos)
        << failure_text(failed);
    EXPECT_EQ(shared->transport.load(), 1) << "the second turn never reached the Provider";
    EXPECT_EQ(shared->tool_executions.load(), 1);
    const auto all = rows(files.provider_db());
    ASSERT_EQ(all.size(), 1U);
    EXPECT_EQ(all[0].state, "succeeded");
}

// (d) ---------------------------------------------------------------------

TEST(ProgramProviderJournalRuntime, FailureAfterDispatchLeavesUncertainMarkerThatReconnectNeverRedispatches) {
    TempDir files("uncertain");
    auto shared = std::make_shared<Shared>();
    shared->on_transport = [](int, const ProviderRequest&) {
        throw std::runtime_error("link lost after the request was sent");
    };
    const std::string owner = "tenant:uncertain";
    std::string run_id;
    {
        Wire wire(files, shared);
        const auto version = wire.admit(owner, Topology::Llm);
        const auto failed = wire.runtime().run(owner, version,
                                               wire.invocation("uncertain-run", "question", Topology::Llm));
        ASSERT_EQ(failed.status(), ProgramTerminalStatus::Failed);
        run_id = failed.run_id();
    }
    EXPECT_EQ(shared->transport.load(), 1);
    const auto before = rows(files.provider_db());
    ASSERT_EQ(before.size(), 1U);
    EXPECT_EQ(before[0].state, "reconciliation_required");
    shared->on_transport = {};   // the Provider is healthy again: a redispatch would now succeed
    Wire reopened(files, shared);
    const auto restored = reopened.runtime().reconnect(owner, run_id).wait();
    EXPECT_EQ(restored.status(), ProgramTerminalStatus::Failed);
    EXPECT_EQ(shared->transport.load(), 1);
    EXPECT_TRUE(same_rows(rows(files.provider_db()), before));
    ASSERT_TRUE(reopened.journal().inspect(owner, before[0].id));
    EXPECT_EQ(reopened.journal().inspect(owner, before[0].id)->state, Journal::State::ReconciliationRequired);
}

TEST(ProgramProviderJournalRuntime, UncertainMarkerSurvivesAdvancedAttemptUntilExternallyReconciled) {
    TempDir files("uncertain-resume");
    auto shared = std::make_shared<Shared>();
    shared->interrupt_on_uncertain = true;
    shared->on_transport = [](int, const ProviderRequest&) {
        throw std::runtime_error("link lost after the request was sent");
    };
    const std::string owner = "tenant:uncertain";
    ProgramResult interrupted;
    {
        Wire wire(files, shared);
        const auto version = wire.admit(owner, Topology::Approval);
        interrupted = wire.runtime().run(owner, version, wire.invocation("uncertain-a", "", Topology::Approval));
        ASSERT_EQ(interrupted.status(), ProgramTerminalStatus::Interrupted) << failure_text(interrupted);
    }
    shared->on_transport = {};   // healthy again: any redispatch would succeed and be visible
    const auto before = rows(files.provider_db());
    ASSERT_EQ(before.size(), 1U);
    EXPECT_EQ(before[0].state, "reconciliation_required");
    ASSERT_EQ(shared->transport.load(), 1);

    // Same persisted state, two continuations.
    TempDir reconciled_files("uncertain-reconciled");
    copy_closed_files(files.path, reconciled_files.path);
    {
        Wire reopened(files, shared);
        const auto resumed = reopened.runtime().resume(owner, "uncertain-a",
            resume_after(interrupted, "trace-uncertain-resume")).wait();
        EXPECT_EQ(resumed.status(), ProgramTerminalStatus::Failed) << "attempt 2 must not re-dispatch";
        EXPECT_EQ(resumed.attempt(), 2U);
        EXPECT_NE(failure_text(resumed).find(
                      "dispatch outcome uncertain; reconciliation required"), std::string::npos)
            << failure_text(resumed);
        EXPECT_EQ(shared->transport.load(), 1);
        EXPECT_TRUE(same_rows(rows(files.provider_db()), before));
    }
    auto isolated = std::make_shared<Shared>();
    isolated->interrupt_on_uncertain = true;
    Wire reconciled(reconciled_files, isolated);
    reconciled.journal().reconcile_success(owner, before[0].id, digest('c'),
                                           neograph::test::success("confirmed externally"));
    const auto completed = reconciled.runtime().resume(owner, "uncertain-a",
        resume_after(interrupted, "trace-uncertain-reconciled")).wait();
    ASSERT_EQ(completed.status(), ProgramTerminalStatus::Completed) << failure_text(completed);
    EXPECT_EQ(completed.attempt(), 2U);
    EXPECT_NE(completed.output().dump().find("confirmed externally"), std::string::npos);
    EXPECT_EQ(isolated->transport.load(), 0) << "reconciled evidence replays without transport";
    const auto after = rows(reconciled_files.provider_db());
    ASSERT_EQ(after.size(), 1U);
    EXPECT_EQ(after[0].state, "succeeded");
    EXPECT_EQ(after[0].original_attempt, "1");
}

TEST(ProgramProviderJournalRuntime, CrashBetweenMarkerAndOutcomeIsNeverRedispatchedByRecovery) {
    TempDir files("crash");
    TempDir image("crash-image");
    auto shared = std::make_shared<Shared>();
    shared->interrupt_before_call = true;
    Options options;
    options.child_capable = true;
    // Snapshot attempt 2 while transport is in flight. Attempt 1 supplied a
    // durable node-interrupt checkpoint, so cold reconnect must actually
    // revisit the runtime-generated slot rather than merely reject a lease.
    shared->on_transport = [&](int, const ProviderRequest&) { crash_image(files.path, image.path); };
    const std::string owner = "tenant:crash";
    {
        Wire wire(files, shared, options);
        const auto version = wire.admit(owner, Topology::Approval);
        const auto paused = wire.runtime().run(owner, version,
            wire.invocation("crash-run", "", Topology::Approval));
        ASSERT_EQ(paused.status(), ProgramTerminalStatus::Interrupted) << failure_text(paused);
        ASSERT_EQ(shared->transport.load(), 0);
        ASSERT_TRUE(rows(files.provider_db()).empty());
        const auto done = wire.runtime().resume(owner, "crash-run",
            resume_after(paused, "trace-crash-resume")).wait();
        ASSERT_EQ(done.status(), ProgramTerminalStatus::Completed) << failure_text(done);
        ASSERT_EQ(done.attempt(), 2U);
    }
    ASSERT_EQ(shared->transport.load(), 1);
    const auto crashed = rows(image.provider_db());
    ASSERT_EQ(crashed.size(), 1U);
    EXPECT_EQ(crashed[0].state, "dispatched");
    EXPECT_EQ(crashed[0].original_attempt, "2");
    {
        SQLiteProgramTransitionStore transitions(image.program_db());
        const auto record = transitions.load(owner, "crash-run");
        ASSERT_TRUE(record);
        ASSERT_TRUE(record->exact_checkpoint());
        EXPECT_FALSE(record->terminal_result());
        EXPECT_EQ(record->continuation().state, ContinuationState::Running);
        EXPECT_EQ(record->continuation().attempt, 2U);
    }

    auto recovery = std::make_shared<Shared>();
    recovery->interrupt_before_call = true;
    Wire restarted(image, recovery, options);
    const auto recovered = restarted.runtime().reconnect(owner, "crash-run").wait();
    EXPECT_EQ(recovered.status(), ProgramTerminalStatus::Failed) << "the lost outcome needs reconciliation";
    EXPECT_EQ(recovered.attempt(), 2U);
    EXPECT_NE(failure_text(recovered).find(
                  "dispatch outcome uncertain; reconciliation required"), std::string::npos)
        << failure_text(recovered);
    EXPECT_EQ(recovery->transport.load(), 0) << "recovery must not send the unconfirmed request again";
    EXPECT_EQ(recovery->tool_executions.load(), 0);
    EXPECT_TRUE(same_rows(rows(image.provider_db()), crashed));
}

TEST(ProgramProviderJournalRuntime, RootExecutionLeaseRejectsCrashRecoveryBeforeFirstCheckpoint) {
    TempDir files("crash-first");
    TempDir image("crash-first-image");
    auto shared = std::make_shared<Shared>();
    shared->on_transport = [&](int, const ProviderRequest&) { crash_image(files.path, image.path); };
    const std::string owner = "tenant:crash";
    {
        Wire wire(files, shared);
        const auto version = wire.admit(owner, Topology::Llm);
        ASSERT_EQ(wire.runtime().run(owner, version,
                      wire.invocation("crash-run", "question", Topology::Llm)).status(),
                  ProgramTerminalStatus::Completed);
    }
    const auto crashed = rows(image.provider_db());
    ASSERT_EQ(crashed.size(), 1U);
    EXPECT_EQ(crashed[0].state, "dispatched");
    auto recovery = std::make_shared<Shared>();
    Wire restarted(image, recovery);
    try {
        (void)restarted.runtime().reconnect(owner, "crash-run");
        FAIL() << "the captured root execution lease must still fence reconnect";
    } catch (const ProgramDiagnosticError& error) {
        EXPECT_EQ(error.diagnostic().code, "P_RUN_LEASE_HELD");
    }
    EXPECT_EQ(recovery->transport.load(), 0);
    EXPECT_TRUE(same_rows(rows(image.provider_db()), crashed));
}

// (e) ---------------------------------------------------------------------

namespace {
// A run that completed its model call, then paused for approval: attempt 1 is
// durable, attempt 2 is about to execute the same logical slot.
struct PausedWithCompletedCall {
    PausedWithCompletedCall() : files("conflict-source") {
        auto shared = std::make_shared<Shared>();
        shared->interrupt_after_call = true;
        Options options;
        options.model_tokens = 0;
        Wire wire(files, shared, options);
        const auto version = wire.admit(owner, Topology::Approval);
        interrupted = wire.runtime().run(owner, version, wire.invocation(run, "", Topology::Approval));
        EXPECT_EQ(interrupted.status(), ProgramTerminalStatus::Interrupted) << failure_text(interrupted);
        EXPECT_EQ(shared->transport.load(), 1);
        original = rows(files.provider_db());
    }
    // Resume attempt 2 in a copy of that state with one thing changed.
    ProgramResult resume_in_copy(const std::function<void(const TempDir&, Shared&, Options&)>& change,
                                 std::vector<Row>& after, int& transport) {
        TempDir copy("conflict-copy");
        copy_closed_files(files.path, copy.path);
        auto shared = std::make_shared<Shared>();
        shared->interrupt_after_call = true;
        Options options;
        options.model_tokens = 0;
        change(copy, *shared, options);
        Wire wire(copy, shared, options);
        auto result = wire.runtime().resume(owner, run, resume_after(interrupted, "trace-conflict")).wait();
        transport = shared->transport.load();
        after = rows(copy.provider_db());
        return result;
    }
    TempDir files;
    const std::string owner = "tenant:conflict";
    const std::string run = "conflict-run";
    ProgramResult interrupted;
    std::vector<Row> original;
};
} // namespace

TEST(ProgramProviderJournalRuntime, UnchangedBindingResumesAndEveryChangedBindingFailsClosed) {
    PausedWithCompletedCall paused;
    ASSERT_EQ(paused.original.size(), 1U);
    ASSERT_EQ(paused.original[0].state, "succeeded");

    std::vector<Row> after;
    int transport = -1;
    const auto control = paused.resume_in_copy([](const TempDir&, Shared&, Options&) {}, after, transport);
    EXPECT_EQ(control.status(), ProgramTerminalStatus::Completed) << failure_text(control);
    EXPECT_EQ(control.attempt(), 2U);
    EXPECT_EQ(transport, 0);
    EXPECT_TRUE(same_rows(after, paused.original));

    struct Change {
        const char* name;
        std::function<void(const TempDir&, Shared&, Options&)> apply;
    };
    const std::vector<Change> changes{
        {"deployment", [](const TempDir&, Shared&, Options& options) { options.deployment = digest('b'); }},
        {"model", [](const TempDir&, Shared& shared, Options&) { shared.node_model = "another-model"; }},
        {"request", [](const TempDir&, Shared& shared, Options&) { shared.node_prompt = "a different question"; }},
    };
    for (const auto& change : changes) {
        SCOPED_TRACE(change.name);
        const auto failed = paused.resume_in_copy(change.apply, after, transport);
        EXPECT_EQ(failed.status(), ProgramTerminalStatus::Failed);
        EXPECT_EQ(failed.attempt(), 2U);
        EXPECT_EQ(transport, 0) << "a conflicting call must not reach the Provider";
        EXPECT_TRUE(same_rows(after, paused.original)) << "and must not rewrite the journal";
    }
    // The persisted record itself disagrees with what the runtime derives for this slot.
    const std::vector<std::pair<const char*, std::string>> tampering{
        {"slot", "UPDATE ng_program_provider_calls SET slot=replace(slot,'\"call_ordinal\":0','\"call_ordinal\":1')"},
        {"request_digest", "UPDATE ng_program_provider_calls SET request_digest='sha256:" + std::string(64, 'e') + "'"},
        {"provider_binding_identity", "UPDATE ng_program_provider_calls SET provider_binding_identity='sha256:" + std::string(64, 'e') + "'"},
        {"model", "UPDATE ng_program_provider_calls SET model='forged-model'"},
        {"provider_name", "UPDATE ng_program_provider_calls SET provider_name='forged-provider'"},
        {"family", "UPDATE ng_program_provider_calls SET family='anthropic.messages'"},
        {"mode", "UPDATE ng_program_provider_calls SET mode='stream'"},
    };
    for (const auto& [column, sql] : tampering) {
        SCOPED_TRACE(column);
        std::vector<Row> tampered;
        const auto failed = paused.resume_in_copy(
            [&](const TempDir& copy, Shared&, Options&) {
                Connection(copy.provider_db()).exec(sql);
                tampered = rows(copy.provider_db());
            }, after, transport);
        EXPECT_EQ(failed.status(), ProgramTerminalStatus::Failed);
        EXPECT_EQ(failed.attempt(), 2U);
        EXPECT_EQ(transport, 0);
        EXPECT_FALSE(same_rows(tampered, paused.original)) << "the tampering changed the row";
        EXPECT_TRUE(same_rows(after, tampered)) << "the runtime neither repaired nor rewrote it";
    }
}

// (f) ---------------------------------------------------------------------

TEST(ProgramProviderJournalRuntime, ReActSecondTurnAfterToolObservationGetsNewSlot) {
    TempDir files("react");
    auto shared = std::make_shared<Shared>();
    shared->script = Script::React;
    const std::string owner = "tenant:react";
    std::string version_id;
    {
        Wire wire(files, shared);
        const auto version = wire.admit(owner, Topology::React);
        version_id = version.id();
        const auto result = wire.runtime().run(owner, version,
                                               wire.invocation("react-run", "question", Topology::React));
        ASSERT_EQ(result.status(), ProgramTerminalStatus::Completed) << failure_text(result);
        EXPECT_NE(result.output().dump().find("answer(question|tool-observation)"), std::string::npos);
    }
    EXPECT_EQ(shared->transport.load(), 2);
    EXPECT_EQ(shared->tool_executions.load(), 1);
    const auto observed = shared->snapshot();
    ASSERT_EQ(observed.size(), 2U);
    EXPECT_FALSE(observed[0].observation);
    EXPECT_TRUE(observed[1].observation) << "the second turn carried the Tool observation";

    const auto all = rows(files.provider_db());
    ASSERT_EQ(all.size(), 2U);
    const auto& first = all[0];
    const auto& second = all[1];
    EXPECT_NE(first.id, second.id);
    EXPECT_NE(first.request, second.request);
    for (const auto* row : {&first, &second}) {
        EXPECT_EQ(row->state, "succeeded");
        EXPECT_EQ(row->original_attempt, "1");
        EXPECT_EQ(row->slot.at("owner_scope"), owner);
        EXPECT_EQ(row->slot.at("program_version_id"), version_id);
        EXPECT_EQ(row->slot.at("run_id"), "react-run");
        EXPECT_EQ(row->slot.at("operation_id"), "root");
        EXPECT_EQ(row->slot.at("node_name"), "llm");
        EXPECT_EQ(row->slot.at("call_ordinal"), 0);
    }
    EXPECT_EQ(first.slot.at("thread_id"), second.slot.at("thread_id"));
    EXPECT_NE(first.slot.at("task_id"), second.slot.at("task_id"))
        << "the second turn is a new task of the same node";

    Wire reopened(files, shared);
    const auto restored = reopened.runtime().reconnect(owner, "react-run").wait();
    EXPECT_EQ(restored.status(), ProgramTerminalStatus::Completed);
    EXPECT_EQ(shared->transport.load(), 2);
    EXPECT_EQ(shared->tool_executions.load(), 1);
    EXPECT_TRUE(same_rows(rows(files.provider_db()), all));
}

TEST(ProgramProviderJournalRuntime, ReActResumedAtAdvancedAttemptKeepsFirstSlotAndAddsSecond) {
    TempDir files("react-resume");
    auto shared = std::make_shared<Shared>();
    shared->script = Script::React;
    const std::string owner = "tenant:react";
    ProgramResult paused;
    std::vector<Row> first_turn;
    {
        Wire wire(files, shared);
        const auto version = wire.admit(owner, Topology::ReactPausedBeforeTools);
        paused = wire.runtime().run(owner, version,
                                    wire.invocation("react-run", "question", Topology::ReactPausedBeforeTools));
        ASSERT_EQ(paused.status(), ProgramTerminalStatus::Interrupted) << failure_text(paused);
        EXPECT_EQ(shared->transport.load(), 1);
        EXPECT_EQ(shared->tool_executions.load(), 0);
        first_turn = rows(files.provider_db());
        ASSERT_EQ(first_turn.size(), 1U);
    }
    Wire reopened(files, shared);
    const auto resumed = reopened.runtime().resume(owner, "react-run",
        resume_after(paused, "trace-react-resume", json(nullptr))).wait();
    ASSERT_EQ(resumed.status(), ProgramTerminalStatus::Completed) << failure_text(resumed);
    EXPECT_EQ(resumed.attempt(), 2U);
    EXPECT_EQ(shared->transport.load(), 2);
    EXPECT_EQ(shared->tool_executions.load(), 1);
    EXPECT_NE(resumed.output().dump().find("answer(question|tool-observation)"), std::string::npos);
    const auto all = rows(files.provider_db());
    ASSERT_EQ(all.size(), 2U);
    EXPECT_TRUE(same_rows({all[0]}, first_turn)) << "turn one is untouched by the advanced attempt";
    EXPECT_EQ(all[0].original_attempt, "1");
    EXPECT_EQ(all[1].original_attempt, "2") << "turn two is a new slot first dispatched in attempt 2";
    EXPECT_NE(all[0].id, all[1].id);
    EXPECT_EQ(all[0].slot.at("thread_id"), all[1].slot.at("thread_id"));
}
